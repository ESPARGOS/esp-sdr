## main/Kconfig.projbuild
```kconfig
menu "ESP-SDR transport"

    config ESP_SDR_UART_ENABLED
        bool "Burst UART0 I/Q transport" if !IDF_TARGET_ESP32 && !IDF_TARGET_ESP32C2
        depends on IDF_TARGET_ESP32H2 || IDF_TARGET_ESP32C2 || IDF_TARGET_ESP32C5 || IDF_TARGET_ESP32C3 || IDF_TARGET_ESP32 || IDF_TARGET_ESP32S2 || IDF_TARGET_ESP32S3 || IDF_TARGET_ESP32C61 || IDF_TARGET_ESP32C6 || IDF_TARGET_ESP32S31
        default y
        help
            Enable the optional USB-to-UART bridge interface. Disable it to
            leave the UART GPIOs unused by the application. Native USB remains
            available on chips that support it. The original ESP32 and ESP32-C2 require UART.

    config ESP_SDR_UART_BAUD
        int "Burst UART0 I/Q baud rate"
        depends on IDF_TARGET_ESP32H2 || IDF_TARGET_ESP32C2 || IDF_TARGET_ESP32C5 || IDF_TARGET_ESP32C3 || IDF_TARGET_ESP32 || IDF_TARGET_ESP32S2 || IDF_TARGET_ESP32S3 || IDF_TARGET_ESP32C61 || IDF_TARGET_ESP32C6 || IDF_TARGET_ESP32S31
        range 115200 2500000 if IDF_TARGET_ESP32C2
        range 115200 3000000 if !IDF_TARGET_ESP32C2
        default 2000000
        help
            The burst I/Q protocol is also available on UART0, 8N1, without
            hardware flow control. The browser baud rate must match this value.
            BAUD 1000000 and BAUD 2000000 can change the running UART rate.
            Resetting the board restores this configured default.

    config ESP_SDR_UART_TX_PIN
        int "Burst UART0 TX GPIO"
        depends on IDF_TARGET_ESP32H2 || IDF_TARGET_ESP32C2 || IDF_TARGET_ESP32C5 || IDF_TARGET_ESP32C3 || IDF_TARGET_ESP32 || IDF_TARGET_ESP32S2 || IDF_TARGET_ESP32S3 || IDF_TARGET_ESP32C61 || IDF_TARGET_ESP32C6 || IDF_TARGET_ESP32S31
        range 0 20 if IDF_TARGET_ESP32C2
        range 0 27 if IDF_TARGET_ESP32H2
        range 0 48 if !IDF_TARGET_ESP32S31 && !IDF_TARGET_ESP32C2 && !IDF_TARGET_ESP32H2
        range 0 63 if IDF_TARGET_ESP32S31
        default 1 if IDF_TARGET_ESP32
        default 24 if IDF_TARGET_ESP32H2
        default 20 if IDF_TARGET_ESP32C2
        default 21 if IDF_TARGET_ESP32C3
        default 58 if IDF_TARGET_ESP32S31
        default 16 if IDF_TARGET_ESP32C6
        default 11 if IDF_TARGET_ESP32C61 || IDF_TARGET_ESP32C5
        default 43

    config ESP_SDR_UART_RX_PIN
        int "Burst UART0 RX GPIO"
        depends on IDF_TARGET_ESP32H2 || IDF_TARGET_ESP32C2 || IDF_TARGET_ESP32C5 || IDF_TARGET_ESP32C3 || IDF_TARGET_ESP32 || IDF_TARGET_ESP32S2 || IDF_TARGET_ESP32S3 || IDF_TARGET_ESP32C61 || IDF_TARGET_ESP32C6 || IDF_TARGET_ESP32S31
        range 0 20 if IDF_TARGET_ESP32C2
        range 0 27 if IDF_TARGET_ESP32H2
        range 0 48 if !IDF_TARGET_ESP32S31 && !IDF_TARGET_ESP32C2 && !IDF_TARGET_ESP32H2
        range 0 63 if IDF_TARGET_ESP32S31
        default 3 if IDF_TARGET_ESP32
        default 23 if IDF_TARGET_ESP32H2
        default 19 if IDF_TARGET_ESP32C2
        default 20 if IDF_TARGET_ESP32C3
        default 59 if IDF_TARGET_ESP32S31
        default 17 if IDF_TARGET_ESP32C6
        default 10 if IDF_TARGET_ESP32C61
        default 12 if IDF_TARGET_ESP32C5
        default 44

    config ESP_SDR_OLED_ENABLED
        bool "Stand-alone spectrum/waterfall on a 72x40 SSD1306 OLED"
        depends on IDF_TARGET_ESP32C3
        default n
        help
            ESP32-C3 SuperMini boards with the 0.42 inch OLED. While no serial
            host holds the lease, the receiver draws a live spectrum and
            waterfall. If no panel answers on I2C the feature stays idle.
            The I2C and button GPIOs are removed from browser GPIO control.
            See docs/displays.md (sdkconfig.defaults.c3oled).

    config ESP_SDR_OLED_SDA
        int "OLED I2C SDA GPIO"
        depends on ESP_SDR_OLED_ENABLED
        default 5

    config ESP_SDR_OLED_SCL
        int "OLED I2C SCL GPIO"
        depends on ESP_SDR_OLED_ENABLED
        default 6

    config ESP_SDR_OLED_BUTTON
        int "Frequency/view button GPIO (active low)"
        depends on ESP_SDR_OLED_ENABLED
        default 9

    config ESP_SDR_OLED_COLUMN_OFFSET
        int "First visible SSD1306 column"
        depends on ESP_SDR_OLED_ENABLED
        range 0 56
        default 28

    config ESP_SDR_OLED_FLIP
        bool "Rotate the OLED image by 180 degrees"
        depends on ESP_SDR_OLED_ENABLED
        default n

    config ESP_SDR_DINMETER
        bool "M5Stack Din Meter stand-alone spectrum/waterfall"
        depends on IDF_TARGET_ESP32S3
        default n
        help
            ST7789 240x135 LCD, rotary encoder (A=41, B=40, button 42) and
            power hold on GPIO46. While no serial host holds the lease the
            receiver draws a live spectrum and waterfall; the knob tunes,
            a press switches it to span adjustment and back.
            See docs/displays.md (sdkconfig.defaults.dinmeter).

    config ESP_SDR_DINMETER_LCD_FLIP
        bool "Rotate the Din Meter LCD image by 180 degrees"
        depends on ESP_SDR_DINMETER
        default n

    config ESP_SDR_DINMETER_ENCODER_REVERSE
        bool "Reverse the encoder direction"
        depends on ESP_SDR_DINMETER
        default n

    config ESP_SDR_DINMETER_COUNTS_PER_DETENT
        int "Quadrature counts per encoder detent"
        depends on ESP_SDR_DINMETER
        range 1 8
        default 4

endmenu
```

## sdkconfig.defaults.esp32
```kconfig
CONFIG_IDF_TARGET="esp32"
CONFIG_ESPTOOLPY_FLASHSIZE_2MB=y
CONFIG_ESP_PHY_ENABLE_CERT_TEST=y
CONFIG_ESP_PHY_DEBUG=y
CONFIG_ESP_CONSOLE_UART_DEFAULT=y
CONFIG_ESP_MAIN_TASK_STACK_SIZE=8192
CONFIG_FREERTOS_HZ=1000
CONFIG_COMPILER_OPTIMIZATION_PERF=y
CONFIG_ESP_DEFAULT_CPU_FREQ_MHZ_240=y
CONFIG_FREERTOS_UNICORE=y
# CONFIG_ESP_WIFI_IRAM_OPT is not set
# CONFIG_ESP_WIFI_RX_IRAM_OPT is not set
# CONFIG_ESP_PHY_IRAM_OPT is not set
# CONFIG_ESP_WIFI_AMPDU_TX_ENABLED is not set
# CONFIG_ESP_WIFI_AMPDU_RX_ENABLED is not set

CONFIG_ESP_SDR_UART_ENABLED=y
CONFIG_ESP_SDR_UART_BAUD=921600
```
